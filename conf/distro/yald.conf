## conf/distro/yald.conf
```bitbake
require conf/distro/poky.conf

DISTRO = "yald"
DISTRO_NAME = "yald (Yet Another Linux Distro)"

SDK_VENDOR = "-yaldsdk"
TARGET_VENDOR = "-yald"

ENABLE_UART:raspberrypi3-64 = "1"

DISTRO_FEATURES:remove = "alsa bluetooth ext2 pcmcia 3g x11 opengl ptest wayland pulseaudio vulkan"
```
